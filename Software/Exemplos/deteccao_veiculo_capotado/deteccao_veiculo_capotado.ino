/* Programa: detecção de veículo capotado
 * Descrição: detecção de veículo capotado, fazendo uso do
 *            OLED para exibição gráfica do estado do veículo
 * Autor: Pedro Bertoleti
 * 
 * Este programa faz uso das bibliotecas de display OLED (SSD1306) da Adafruit:
 * - https://github.com/adafruit/Adafruit_SSD1306
 * - https://github.com/adafruit/Adafruit-GFX-Library
 * 
 * Além disso, este programa faz uso das seguintes bibliotecas para o uso do
 * IMU MPU6050:
 * - https://github.com/adafruit/Adafruit_MPU6050
 * - https://github.com/adafruit/Adafruit_Sensor
 */

#include <Adafruit_GFX.h>
#include <Adafruit_SSD1306.h>
#include <Adafruit_MPU6050.h>
#include <Adafruit_Sensor.h>
#include <math.h>

/* 
 *  Imagens
 */
const unsigned char carro_capotado [] PROGMEM = {
  0xff, 0xff, 0xff, 0xff, 0xff, 0xff, 0xff, 0xff, 0xff, 0xff, 0xff, 0xff, 0xff, 0xff, 0xff, 0xff, 
  0xff, 0xff, 0xff, 0xff, 0xff, 0xff, 0xff, 0xff, 0xff, 0xff, 0xff, 0xff, 0xff, 0xff, 0xff, 0xff, 
  0xff, 0xff, 0xff, 0xff, 0xff, 0xff, 0xff, 0xff, 0xff, 0xff, 0xff, 0xff, 0xff, 0xff, 0xff, 0xff, 
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  0xff, 0xff, 0xff, 0xff, 0xff, 0xff, 0xff, 0xff, 0xff, 0xff, 0xff, 0xff, 0xff, 0xff, 0xff, 0xff
};

const unsigned char carro_ok [] PROGMEM = {
  0xff, 0xff, 0xff, 0xff, 0xff, 0xff, 0xff, 0xff, 0xff, 0xff, 0xff, 0xff, 0xff, 0xff, 0xff, 0xff, 
  0xff, 0xff, 0xff, 0xff, 0xff, 0xff, 0xff, 0xff, 0xff, 0xff, 0xff, 0xff, 0xff, 0xff, 0xff, 0xff, 
  0xff, 0xff, 0xff, 0xff, 0xff, 0xff, 0xff, 0xff, 0xff, 0xff, 0xff, 0xff, 0xff, 0xff, 0xff, 0xff, 
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  0xff, 0xff, 0xff, 0xff, 0xff, 0xff, 0xff, 0xff, 0xff, 0xff, 0xff, 0xff, 0xff, 0xff, 0xff, 0xff
};

/* Definições - OLED */
#define OLED_CLEAR_LINE      "                     "
#define OLED_LINE_MAX_SIZE   21
#define OLED_SDA_PIN         4
#define OLED_SCL_PIN         15
#define OLED_ADDRESS         0x3C
#define OLED_RESET           16 
#define OLED_SCREEN_HEIGHT   64
#define OLED_SCREEN_WIDTH    128
#define OLED_LINHA_1         0
#define OLED_LINHA_2         10
#define OLED_LINHA_3         20
#define OLED_LINHA_4         30
#define OLED_LINHA_5         40
#define OLED_LINHA_6         50

/* Definição - GPIO do LED */
#define GPIO_LED   23

/* Definição - aceleração da gravidade */
#define VALOR_GRAVIDADE    9.80665  // m/s²

/* Definições - acelerômetro */
#define NUM_LEITURAS_CALIBRACAO          200
#define TEMPO_ENTRE_LEITURAS_IMU         10    //ms

/* Definições - thresholds (acelerômetro e giroscópio) */
#define MIN_THRESHOLD_ACC                      0.3  //m/s²
#define MIN_THRESHOLD_GYRO                     2.0  //rad/s

/* Definições - filtro Mahony */
#define sampleFreq  512.0f          //frequencia de amostragem (em Hz)
#define twoKpDef    (256.0f * 1.0f)   
#define twoKiDef    (32.0f * 1.0f)  

/* Definições - ângulos de tombamento */
#define ANGULO_TOMBAMENTO_MINIMO    -45
#define ANGULO_TOMBAMENTO_MAXIMO    45

/* Variáveis do filtro Mahony */
volatile float twoKp = twoKpDef; //2 * ganho proporcional (Kp)
volatile float twoKi = twoKiDef; //2 * ganho integral (Ki)
volatile float q0 = 1.0f, q1 = 0.0f, q2 = 0.0f, q3 = 0.0f; 
volatile float integralFBx = 0.0f,  integralFBy = 0.0f, integralFBz = 0.0f; //erros da parte integral

/* Variaveis globais */
float offset_ax = 0;
float offset_ay = 0;
float offset_az = 0;
float offset_gx = 0;
float offset_gy = 0;
float offset_gz = 0;
int estado_led;
unsigned long timestamp_leitura_IMU;
Adafruit_MPU6050 mpu;
Adafruit_SSD1306 display(OLED_SCREEN_WIDTH, 
                         OLED_SCREEN_HEIGHT, 
                         &Wire, 
                         OLED_RESET, 
                         100000UL, 
                         100000UL);

/* Protótipos */
void calibra_acc_giroscopio(void);   
float invSqrt(float x);
void Mahony_AHS_update(float gx, float gy, float gz, float ax, float ay, float az);
void obtem_angulos_de_euler(float * ptr_roll, float * ptr_pitch, float * ptr_yaw);
unsigned long diferenca_tempo(unsigned long timestamp_referencia);
                      
/*
 * Implementações
 */

/* Função: calcula diferença de tempo (ms) entre o timestamp atual e
 *         uma referência
 * Parâmetros: timestamp de referência
 * Retorno: diferença de tempo (ms)
 */
unsigned long diferenca_tempo(unsigned long timestamp_referencia)
{
    unsigned long diferenca_tempo;

    diferenca_tempo = millis() - timestamp_referencia;
    return diferenca_tempo;
}

/* Função: filtro Mahony
 * Parâmetros: - giroscópio nos 3 eixos (gx, gy e gz)
 *             - acelerômetro nos 3 eixos (ax, ay e az) 
 * Retorno: nenhum
 */
void Mahony_AHS_update(float gx, float gy, float gz, float ax, float ay, float az)
{
    float recipNorm;
    float halfvx, halfvy, halfvz;
    float halfex, halfey, halfez;
    float qa, qb, qc;

    if(!((ax == 0.0f) && (ay == 0.0f) && (az == 0.0f))) 
    {
        recipNorm = invSqrt(ax * ax + ay * ay + az * az);
        ax *= recipNorm;
        ay *= recipNorm;
        az *= recipNorm;        
  
        halfvx = q1 * q3 - q0 * q2;
        halfvy = q0 * q1 + q2 * q3;
        halfvz = q0 * q0 - 0.5f + q3 * q3;
    
        halfex = (ay * halfvz - az * halfvy);
        halfey = (az * halfvx - ax * halfvz);
        halfez = (ax * halfvy - ay * halfvx);
  
        if(twoKi > 0.0f) 
        {
            integralFBx += twoKi * halfex * (1.0f / sampleFreq);  // integral error scaled by Ki
            integralFBy += twoKi * halfey * (1.0f / sampleFreq);
            integralFBz += twoKi * halfez * (1.0f / sampleFreq);
            gx += integralFBx;
            gy += integralFBy;
            gz += integralFBz;
        }
        else 
        {
            integralFBx = 0.0f;
            integralFBy = 0.0f;
            integralFBz = 0.0f;
        }
  
        gx += twoKp * halfex;
        gy += twoKp * halfey;
        gz += twoKp * halfez;
    }
    
    gx *= (0.5f * (1.0f / sampleFreq));
    gy *= (0.5f * (1.0f / sampleFreq));
    gz *= (0.5f * (1.0f / sampleFreq));
    qa = q0;
    qb = q1;
    qc = q2;
    q0 += (-qb * gx - qc * gy - q3 * gz);
    q1 += (qa * gx + qc * gz - q3 * gy);
    q2 += (qa * gy - qb * gz + q3 * gx);
    q3 += (qa * gz + qb * gy - qc * gx); 
    
    recipNorm = invSqrt(q0 * q0 + q1 * q1 + q2 * q2 + q3 * q3);
    q0 *= recipNorm;
    q1 *= recipNorm;
    q2 *= recipNorm;
    q3 *= recipNorm;
}

/* Função: fast inverse square-root */
float invSqrt(float x)
{
    float halfx = 0.5f * x;
    float y = x;
    long i = *(long*)&y;
    i = 0x5f3759df - (i>>1);
    y = *(float*)&i;
    y = y * (1.5f - (halfx * y * y));
    y = y * (1.5f - (halfx * y * y));
    return y;
}

/* Função: obtem angulos de euler a partir dos quaternions
 * Parâmetros: - Ponteiro para roll 
 *             - Ponteiro para pitch
 *             - Ponteiro para yaw
 * Retorno: nenhum
 */
void obtem_angulos_de_euler(float * ptr_roll, float * ptr_pitch, float * ptr_yaw)
{
    *ptr_roll = atan2f(q0*q1 + q2*q3, 0.5f - q1*q1 - q2*q2) * (180.0/M_PI);
    *ptr_pitch = asinf(-2.0f * (q1*q3 - q0*q2)) * (180.0/M_PI);
    *ptr_yaw = atan2f(q1*q2 + q0*q3, 0.5f - q2*q2 - q3*q3) * (180.0/M_PI);
}
 

/* Função: faz calibração do acelerometro e giroscopio
 * Parametros: nenhum 
 * Retorno: nenhum
 */
void calibra_acc_giroscopio(void)
{
    int i;
    sensors_event_t a, g, temp;
    float soma_ax = 0;
    float soma_ay = 0;
    float soma_az = 0;
    float soma_gx = 0;
    float soma_gy = 0;
    float soma_gz = 0;

    for (i=0; i<NUM_LEITURAS_CALIBRACAO; i++)
    {
        mpu.getEvent(&a, &g, &temp);
        
        soma_ax = soma_ax + a.acceleration.x;
        soma_ay = soma_ay + a.acceleration.y;
        soma_az = soma_az + a.acceleration.z;

        soma_gx = soma_gx + g.gyro.x;
        soma_gy = soma_gy + g.gyro.y;
        soma_gz = soma_gz + g.gyro.z;        
    }

    offset_ax = soma_ax/NUM_LEITURAS_CALIBRACAO;
    offset_ay = soma_ay/NUM_LEITURAS_CALIBRACAO;
    offset_az = VALOR_GRAVIDADE - (soma_az/NUM_LEITURAS_CALIBRACAO);

    offset_gx = soma_gx/NUM_LEITURAS_CALIBRACAO;
    offset_gy = soma_gy/NUM_LEITURAS_CALIBRACAO;
    offset_gz = soma_gz/NUM_LEITURAS_CALIBRACAO;    
}

void setup() 
{
    Serial.begin(115200);

    /* Configuração do LED */
    pinMode(GPIO_LED, OUTPUT);
    estado_led = HIGH;
    digitalWrite(GPIO_LED, estado_led);
        
    /* Inicializa I²C (para comunicação com OLED e MPU6050)*/
    Wire.begin(OLED_SDA_PIN, OLED_SCL_PIN);

    /* Inicializa MPU6050 */
    if (!mpu.begin()) 
    {
        Serial.println("ERRO: falha ao inicializar MPU6050. O ESP32 reiniciará em 1s...");
        delay(1000);
        ESP.restart();
    }
    else
    {
        /* Configura MPU6050 e faz calibração do
           acelerômetro e giroscópio */
        mpu.setAccelerometerRange(MPU6050_RANGE_2_G);
        mpu.setGyroRange(MPU6050_RANGE_500_DEG);
        mpu.setFilterBandwidth(MPU6050_BAND_5_HZ);
        calibra_acc_giroscopio();
    }

    /* Inicializa display */
    if(!display.begin(SSD1306_SWITCHCAPVCC, OLED_ADDRESS)) 
    { 
        Serial.println("[ERRO] não foi possivel inicializar display. O NodeMCU será reiniciado em 1s...");
        delay(1000);
        ESP.restart();
    }
    else
    {
        Serial.println("Display inicializado.");
        display.clearDisplay();
        display.setTextColor(WHITE);
        display.setTextSize(1);
        display.setCursor(0,OLED_LINHA_1);
        display.println("   Kit wifi Heltec");
        display.setCursor(0,OLED_LINHA_2);
        display.println("        LoRa V1");
        display.setCursor(0,OLED_LINHA_3);
        display.println("_____________________");
        display.setCursor(0,OLED_LINHA_5);
        display.println("Pedro Bertoleti");
        display.setCursor(0,OLED_LINHA_6);
        display.println("pedrobertoleti.com.br");
        display.display();
        delay(500);
    }

    /* Inicializa temporização das medições de
       acelerômetro e giroscópio */
    timestamp_leitura_IMU = millis();
}

void loop() 
{
    sensors_event_t a, g, temp;
    float roll_atual;
    float pitch_atual;
    float yaw_atual;
   
    /* Verifica se é o momento de ler a IMU (acelerometro e giroscopio) e fazer
       cálculos e verificações dos ângulos de Euler (roll, pitch e yaw) */
    if (diferenca_tempo(timestamp_leitura_IMU) >= TEMPO_ENTRE_LEITURAS_IMU)
    {
        /* Faz leitura da aceleração, giroscópio e faz calculo de pitch e roll
           com filtro Mahony */    
        mpu.getEvent(&a, &g, &temp);        
        Mahony_AHS_update(g.gyro.x, g.gyro.y, g.gyro.z, 
                          a.acceleration.x, a.acceleration.y, a.acceleration.z);
                          
        obtem_angulos_de_euler(&roll_atual, &pitch_atual, &yaw_atual);

        Serial.print("Roll: ");
        Serial.print(roll_atual);
        Serial.println(" graus");
        Serial.print("Pitch: ");
        Serial.print(pitch_atual);
        Serial.println(" graus");
        Serial.print("Yaw: ");
        Serial.print(yaw_atual);
        Serial.println(" graus");

        /* Desenha a figura correspondente (carro capotado ou normal) */
        display.clearDisplay();
        display.setTextColor(BLACK);
        display.setTextSize(2);

        if ( (roll_atual > ANGULO_TOMBAMENTO_MAXIMO) || 
             (roll_atual < ANGULO_TOMBAMENTO_MINIMO) )
        {
            display.drawBitmap(0, 0, carro_capotado, 128, 64, 1); 
            display.setCursor(55,OLED_LINHA_6);
            display.println("PERIGO"); 
        }
        else
        {
            display.drawBitmap(0, 0, carro_ok, 128, 64, 1);  
            display.setCursor(70,OLED_LINHA_3);
            display.println("Ok"); 
        }

        display.display();

        /* Pisca LED da placa */
        if (estado_led == LOW)
            estado_led = HIGH;
        else
            estado_led = LOW;
        digitalWrite(GPIO_LED, estado_led);
        
        /* Reinicia referência de tempo para ler IMU */
        timestamp_leitura_IMU = millis();    
    }
}